## config/west.yml
```yaml
manifest:
  remotes:
    - name: zmkfirmware
      url-base: https://github.com/zmkfirmware
    - name: barbellboards
      url-base: https://github.com/barbellboards
    - name: infused-kim
      url-base: https://github.com/infused-kim
  projects:
    - name: zmk
      remote: infused-kim
      revision: my-changes/split-encoder
      import: app/west.yml
  self:
    path: config
```
